## src/nrf-code/sample.yaml
```yaml
sample:
  name: nRF52833 BME280 BLE Sensor
  
common: 
    sysbuild: true
    integration_platforms: 
      - nrf52833dk/nrf52833
    platform_allow: 
      - nrf52833dk/nrf52833
    
tests:
  nrf_bme280:
    harness: console
    harness_config:
      type: one_line
      regex:
        - "BME280 BLE Service initialized"
    timeout: 15
```
